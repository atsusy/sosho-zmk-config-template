#include "sosho_R.dtsi"

&spi1 { status = "okay"; };
&trackball { status = "okay"; };
&trackball_listener {
	status = "okay";
	input-processors = <&zip_xy_transform (INPUT_TRANSFORM_X_INVERT | INPUT_TRANSFORM_Y_INVERT)>;

	scroll {
		layers = <1>;
		input-processors = <
			&zip_xy_transform (INPUT_TRANSFORM_X_INVERT | INPUT_TRANSFORM_Y_INVERT)
			&zip_x_scaler 0 1          /* 横成分を捨てて縦専用化 */
			&zip_y_scaler 1 8          /* hi-res無し(素のホイール)。Keyball並みの数ノッチに調整。速すぎ/遅すぎはここで */
			&zip_xy_to_scroll_mapper
		>;
	};
};

/* 左側ポインティングの受け口。
 * 左手側にはトラックパッドもトラックボールも載っていないので、この4ノードは
 * 何も受け取らないまま常駐しているだけだった（memo.md が「使わない方を disabled に
 * すると動作が更に軽くなる」と書いているのがまさにここ）。
 * 左にポインティングデバイスを載せたら、対応する側だけコメントを外すこと。
 */
/*
&glidepoint_split { status = "okay"; };
&glidepoint_split_listener { status = "okay"; };

&trackball_split { status = "okay"; };
&trackball_split_listener { status = "okay"; };
*/
