## boards/shields/sosho/Kconfig.shield
```kconfig
config SHIELD_SOSHO_R_TRACKPAD
    def_bool $(shields_list_contains,sosho_R_trackpad)

config SHIELD_SOSHO_R_TRACKBALL
    def_bool $(shields_list_contains,sosho_R_trackball)

config SHIELD_SOSHO_L_TRACKPAD
    def_bool $(shields_list_contains,sosho_L_trackpad)

config SHIELD_SOSHO_L_TRACKBALL
    def_bool $(shields_list_contains,sosho_L_trackball)
```

## config/boards/shields/sosho/Kconfig.defconfig
```kconfig
if SHIELD_SOSHO_R_TRACKPAD || SHIELD_SOSHO_R_TRACKBALL

config ZMK_KEYBOARD_NAME
    default "sosho"

config ZMK_SPLIT
    default y

config ZMK_SPLIT_ROLE_CENTRAL
    default y

config ZMK_POINTING
    default y

config SPI
    default y

endif

if SHIELD_SOSHO_L_TRACKPAD || SHIELD_SOSHO_L_TRACKBALL

config ZMK_KEYBOARD_NAME
    default "sosho"

config ZMK_SPLIT
    default y

config INPUT
    default y

config ZMK_POINTING
    default y

config SPI
    default y

endif
```
