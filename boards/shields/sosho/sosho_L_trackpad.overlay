#include "sosho_L.dtsi"

/* この個体の左側にはトラックパッドが載っていない。
 * 有効のままだと pinnacle_init() が Firmware ASIC ID チェックで失敗して終わるだけなので、
 * SPI0ごと落として無駄な初期化と消費電力をなくす。
 * トラックパッドを載せたら、以下のコメントを外して
 * sosho_L_trackpad.conf の CONFIG_INPUT_PINNACLE=y も戻すこと。
 * （中枢側 sosho_R_trackball.overlay の glidepoint_split_listener も同時に戻す）
 */
/*
&spi0 { status = "okay"; };
&glidepoint {
    status = "okay";
    invert-x;
};
&glidepoint_split {
    status = "okay";
    device = <&glidepoint>;
};
*/
